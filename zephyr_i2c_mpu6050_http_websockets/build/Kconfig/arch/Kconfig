## zephyr_i2c_mpu6050_http_websockets/build/Kconfig/arch/Kconfig
```kconfig
# Load arch Kconfig descriptions.
osource "/home/tech/zephyrproject/zephyr/arch/x86/Kconfig"
osource "/home/tech/zephyrproject/zephyr/arch/xtensa/Kconfig"
osource "/home/tech/zephyrproject/zephyr/arch/sparc/Kconfig"
osource "/home/tech/zephyrproject/zephyr/arch/riscv/Kconfig"
osource "/home/tech/zephyrproject/zephyr/arch/posix/Kconfig"
osource "/home/tech/zephyrproject/zephyr/arch/nios2/Kconfig"
osource "/home/tech/zephyrproject/zephyr/arch/mips/Kconfig"
osource "/home/tech/zephyrproject/zephyr/arch/arm64/Kconfig"
osource "/home/tech/zephyrproject/zephyr/arch/arm/Kconfig"
osource "/home/tech/zephyrproject/zephyr/arch/arc/Kconfig"
```
